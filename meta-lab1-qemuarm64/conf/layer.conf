## meta-lab1-qemuarm64/conf/layer.conf
```bitbake
# We have a conf and classes directory, add to BBPATH
BBPATH := "${BBPATH}:${LAYERDIR}"

# We have a recipes directory, add to BBFILES
BBFILES := "${BBFILES} ${LAYERDIR}/recipes-*/*/*.bb \
	${LAYERDIR}/recipes-*/*/*.bbappend"

BBFILE_COLLECTIONS += "lab1-qemuarm64"
BBFILE_PATTERN_lab1-qemuarm64 := "^${LAYERDIR}/"
BBFILE_PRIORITY_lab1-qemuarm64 = "6"

LAYERSERIES_COMPAT_lab1-qemuarm64 = "kirkstone"
```

## meta-lab1-qemux86/conf/machine/lab1-qemux86.conf
```bitbake
#@TYPE: Machine
#@NAME: lab1-qemux86

#@DESCRIPTION: Machine configuration for lab1-qemux86 systems

PREFERRED_PROVIDER_virtual/kernel ?= "linux-korg"

PREFERRED_PROVIDER_virtual/xserver ?= "xserver-xorg"
PREFERRED_PROVIDER_virtual/libgl ?= "mesa"
PREFERRED_PROVIDER_virtual/libgles1 ?= "mesa"
PREFERRED_PROVIDER_virtual/libgles2 ?= "mesa"

QB_SYSTEM_NAME = "qemu-system-i386"

require conf/machine/include/qemu.inc
require conf/machine/include/tune-i586.inc
require conf/machine/include/qemuboot-x86.inc

MACHINE_FEATURES += "x86"
KERNEL_IMAGETYPE = "bzImage"
SERIAL_CONSOLE = "115200 ttyS0"
XSERVER ?= "xserver-xorg \
           mesa-driver-swrast \
           xf86-input-vmmouse \
           xf86-input-keyboard \
           xf86-input-evdev \
           xf86-video-vmware"
```

## meta-lab2-qemux86/conf/machine/lab2-qemux86.conf
```bitbake
#@TYPE: Machine
#@NAME: lab2-qemux86

#@DESCRIPTION: Machine configuration for lab2-qemux86 systems

PREFERRED_PROVIDER_virtual/kernel ?= "linux-yocto"
PREFERRED_VERSION_linux-yocto ?= "5.10%"
#PREFERRED_VERSION_linux-yocto ?= "5.4%"

QB_SYSTEM_NAME = "qemu-system-i386"

PREFERRED_PROVIDER_virtual/xserver ?= "xserver-xorg"
PREFERRED_PROVIDER_virtual/libgl ?= "mesa"
PREFERRED_PROVIDER_virtual/libgles1 ?= "mesa"
PREFERRED_PROVIDER_virtual/libgles2 ?= "mesa"

require conf/machine/include/qemu.inc
require conf/machine/include/tune-i586.inc
require conf/machine/include/qemuboot-x86.inc

MACHINE_FEATURES += "x86"
KERNEL_IMAGETYPE = "bzImage"
SERIAL_CONSOLE = "115200 ttyS0"
XSERVER ?= "xserver-xorg \
           mesa-driver-swrast \
           xf86-input-vmmouse \
           xf86-input-keyboard \
           xf86-input-evdev \
           xf86-video-vmware"
```

## meta-lab3-qemux86/conf/layer.conf
```bitbake
# We have a conf and classes directory, add to BBPATH
BBPATH := "${BBPATH}:${LAYERDIR}"

# We have a recipes directory, add to BBFILES
BBFILES := "${BBFILES} ${LAYERDIR}/recipes-*/*/*.bb \
	${LAYERDIR}/recipes-*/*/*.bbappend"

BBFILE_COLLECTIONS += "lab3-qemux86"
BBFILE_PATTERN_lab3-qemux86 := "^${LAYERDIR}/"
BBFILE_PRIORITY_lab3-qemux86 = "6"

LAYERSERIES_COMPAT_lab3-qemux86 = "honister"
```

## meta-lab4-qemux86/conf/layer.conf
```bitbake
# We have a conf and classes directory, add to BBPATH
BBPATH := "${BBPATH}:${LAYERDIR}"

# We have a recipes directory, add to BBFILES
BBFILES := "${BBFILES} ${LAYERDIR}/recipes-*/*/*.bb \
	${LAYERDIR}/recipes-*/*/*.bbappend"

BBFILE_COLLECTIONS += "lab4-qemux86"
BBFILE_PATTERN_lab4-qemux86 := "^${LAYERDIR}/"
BBFILE_PRIORITY_lab4-qemux86 = "6"

LAYERSERIES_COMPAT_lab4-qemux86 = "hardknott"
```

## meta-lab4-qemux86/conf/machine/lab4-qemux86.conf
```bitbake
#@TYPE: Machine
#@NAME: lab4-qemux86

#@DESCRIPTION: Machine configuration for lab4-qemux86 systems

PREFERRED_PROVIDER_virtual/kernel ?= "linux-yocto-custom"

PREFERRED_PROVIDER_virtual/xserver ?= "xserver-xorg"
PREFERRED_PROVIDER_virtual/libgl ?= "mesa"
PREFERRED_PROVIDER_virtual/libgles1 ?= "mesa"
PREFERRED_PROVIDER_virtual/libgles2 ?= "mesa"

QB_SYSTEM_NAME = "qemu-system-i386"

require conf/machine/include/qemu.inc
require conf/machine/include/tune-i586.inc
require conf/machine/include/qemuboot-x86.inc

MACHINE_FEATURES += "x86"
KERNEL_IMAGETYPE = "bzImage"
SERIAL_CONSOLE = "115200 ttyS0"
XSERVER ?= "xserver-xorg \
           mesa-driver-swrast \
           xf86-input-vmmouse \
           xf86-input-keyboard \
           xf86-input-evdev \
           xf86-video-vmware"

MACHINE_ESSENTIAL_EXTRA_RRECOMMENDS += "hello-mod"
```
